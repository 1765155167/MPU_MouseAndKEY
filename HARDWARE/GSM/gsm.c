#include "gsm.h"
#include "delay.h"
#include "usart.h"

#define Buf2_Max 200 					  //串口2缓存长度
/*************	本地常量声明	**************/
static char *content="0891683110701605F011000D91687155206933F90008AA0C6D4B8BD55DF27ECF5B8C6210";//发送短信内容
/************************短信内容解析**************************************/
/*
   //短信中心号（倒序）      目标手机（倒序）         短信内容（测试已经完成）
     8613010761500F          8617550296339F          
0891 683110701605F0 11000D91 687155206933F9 0008AA0C 6D4B8BD55DF27ECF5B8C6210
*/
/*************  本地变量声明	*********************************************/
char Uart2_Buf[Buf2_Max]; //串口2接收缓存
u8 Times=0,First_Int = 0,shijian=0;
vu8 Timer0_start;	//定时器0延时启动计数器


/*******************************************************************************
* 函数名  : USART2_IRQHandler
* 描述    : 串口1中断服务程序
* 输入    : 无
* 返回    : 无 
* 说明    : 
*******************************************************************************/
void USART2_IRQHandler(void)                	
{
			u8 Res=0;
			Res =USART_ReceiveData(USART2);
			Uart2_Buf[First_Int] = Res;  	  //将接收到的字符串存到缓存中
			First_Int++;                			//缓存指针向后移动
			if(First_Int > Buf2_Max)       		//如果缓存满,将缓存指针指向缓存的首地址
			{
				First_Int = 0;
			}    
} 	
/*******************************************************************************
* 函数名 : CLR_Buf2
* 描述   : 清除串口2缓存数据
* 输入   : 
* 输出   : 
* 返回   : 
* 注意   : 
*******************************************************************************/
void CLR_Buf2(void)
{
	u16 k;
	for(k=0;k<Buf2_Max;k++)      //将缓存内容清零
	{
		Uart2_Buf[k] = 0x00;
	}
    First_Int = 0;              //接收字符串的起始存储位置
}

/*******************************************************************************
* 函数名 : Find
* 描述   : 判断缓存中是否含有指定的字符串
* 输入   : 
* 输出   : 
* 返回   : unsigned char:1 找到指定字符，0 未找到指定字符 
* 注意   : 
*******************************************************************************/

u8 Find(char *a)
{ 
  if(strstr(Uart2_Buf,a)!=NULL)
	    return 1;
	else
			return 0;
}

/*******************************************************************************
* 函数名 : Second_AT_Command
* 描述   : 发送AT指令函数
* 输入   : 发送数据的指针、希望接收到的应答、发送等待时间(单位：S)
* 输出   : 
* 返回   : 
* 注意   : 
*******************************************************************************/

void Second_AT_Command(char *b,char *a,u8 wait_time)         
{
	u8 i;
	char *c;
	c = b;										//保存字符串地址到c
	CLR_Buf2(); 
  i = 0;
	while(i == 0)                    
	{
		if(!Find(a)) 
		{
			if(Timer0_start == 0)
			{
				b = c;							//将字符串地址给b
				for (; *b!='\0';b++)
				{
					while(USART_GetFlagStatus(USART2, USART_FLAG_TC)==RESET);
					USART_SendData(USART2,*b);
				}
				UART2_SendLR();	
				Times = 0;
				shijian = wait_time;
				Timer0_start = 1;
		   }
    }
 	  else
		{
			i = 1;
			Timer0_start = 0;
		}
	}
	CLR_Buf2(); 
}

/*******************************************************************************
* 函数名 : Set_Pdu_Mode
* 描述   : 设置短信为PDU文本模式
* 输入   : 
* 输出   : 
* 返回   : 
* 注意   : 
*******************************************************************************/
void Set_Pdu_Mode(void)
{
	Second_AT_Command("ATE0","OK",3);										  //取消回显	
	Second_AT_Command("AT+CMGF=0","OK",3);								//设置PDU模式	
	Second_AT_Command("AT+CPMS=\"SM\",\"SM\",\"SM\"","OK",3);//所有操作都在SIM卡中进行
}
/*******************************************************************************
* 函数名 : Send_Pdu_Sms
* 描述   : 发送PDU文本短信
* 输入   : 
* 输出   : 
* 返回   : 
* 注意   : 
*******************************************************************************/
void Send_Pdu_Sms(void)
{

	Second_AT_Command("AT+CMGS=27",">",3); //发送数据长度：27（具体的计算方法看串口调试比较）接收到“>”才发送短信内容
	UART2_SendString(content);     //发送短信内容
	USART_SendData(USART2 ,0X1A);  //发送结束符
  UART2_SendLR();
}


/*******************************************************************************
* 函数名 : Wait_CREG
* 描述   : 等待模块注册成功
* 输入   : 
* 输出   : 
* 返回   : 
* 注意   : 
*******************************************************************************/
int Wait_CREG(void)
{
	u8 i;
	u8 k;
	int a=0;
	i = 0;
	CLR_Buf2();
  while(i == 0)        			
	{
		a++;
		if(a>5) return 0;
		CLR_Buf2();        
		UART2_SendString("AT+CREG?");   //查找模块是否注册成功
		UART2_SendLR();
		delay_ms(5000);		
	    for(k=0;k<Buf2_Max;k++)      			
    	{
			if(Uart2_Buf[k] == ':')
			{
				if((Uart2_Buf[k+4] == '1')||(Uart2_Buf[k+4] == '5'))  //说明模块已经注册成功
				{
					i = 1;
				  break;
				}
			}
		}
	}
	return 1;
}
